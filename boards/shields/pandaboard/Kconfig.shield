## boards/shields/pandaboard/Kconfig.shield
```kconfig
# Copyright (c) 2020 Pete Johanson
# SPDX-License-Identifier: MIT

config SHIELD_PANDABOARD_LEFT
    def_bool $(shields_list_contains,pandaboard_left)

config SHIELD_PANDABOARD_RIGHT
    def_bool $(shields_list_contains,pandaboard_right)
```
