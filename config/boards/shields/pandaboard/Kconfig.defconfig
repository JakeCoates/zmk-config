## config/boards/shields/pandaboard/Kconfig.defconfig
```kconfig
if SHIELD_PANDABOARD_RIGHT

config ZMK_KEYBOARD_NAME
    default "pandaboard"

config ZMK_SPLIT_BLE_ROLE_CENTRAL
	default y

endif

if SHIELD_PANDABOARD_LEFT || SHIELD_PANDABOARD_RIGHT

config ZMK_SPLIT
    default y

endif
```

## config/boards/shields/pandaboard/Kconfig.shield
```kconfig
config SHIELD_PANDABOARD_LEFT
    def_bool $(shields_list_contains,pandaboard_left)

config SHIELD_PANDABOARD_RIGHT
    def_bool $(shields_list_contains,pandaboard_right)
```
